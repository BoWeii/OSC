ENTRY(_start)
SECTIONS
{
  . = 0x60000;
  .text.boot : { *(.text.boot) }
  .text :  { *(.text) }
  .rodata : { *(.rodata) }
  .data : { *(.data) }
  . = ALIGN(0x8);
  bss_begin = .;
  .bss : { *(.bss*) } 
  bss_end = .;  
}
